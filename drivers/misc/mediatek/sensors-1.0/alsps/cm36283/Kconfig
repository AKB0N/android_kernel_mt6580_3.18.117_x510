## drivers/misc/mediatek/sensors-1.0/alsps/cm36283/Kconfig
```kconfig
config MTK_CM36283
	tristate "cm36283 for MediaTek package"
	default n
	help
	  It support different type sensor
	  in this platform. If this option
	  is set, it will support sensor CM36283
	  which integrates a proximity sensor, a color sensor.
```
